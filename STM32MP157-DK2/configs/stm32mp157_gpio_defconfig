## STM32MP157-DK2/configs/stm32mp157_gpio_defconfig
```kconfig
#
# STM32MP157-DK2 GPIO configuration
#

# GPIO subsystem
CONFIG_GPIOLIB=y
CONFIG_GPIOLIB_FASTPATH_LIMIT=512

# GPIO character device interface
CONFIG_GPIO_CDEV=y
CONFIG_GPIO_CDEV_V1=y

# GPIO sysfs compatibility
CONFIG_GPIO_SYSFS=y

# STM32 GPIO controller
CONFIG_GPIO_STM32=y

# GPIO pin controller
CONFIG_PINCTRL=y
CONFIG_PINCTRL_STM32=y

# GPIO interrupts
CONFIG_GENERIC_IRQ_CHIP=y
CONFIG_IRQ_DOMAIN=y

# Device Tree
CONFIG_OF=y
CONFIG_OF_GPIO=y

# GPIO debug support
CONFIG_DEBUG_FS=y

# LED subsystem
CONFIG_LEDS_CLASS=y
CONFIG_LEDS_GPIO=y

# Input subsystem for push buttons
CONFIG_INPUT=y
CONFIG_INPUT_EVDEV=y
CONFIG_INPUT_GPIO_KEYS=y

# PWM support
CONFIG_PWM=y
CONFIG_PWM_STM32=y

# Userspace GPIO support
CONFIG_GPIO_CDEV=y
```

## STM32MP157-DK2/yocto/meta-virtual-gpio/conf/layer.conf
```bitbake
BBPATH .= ":${LAYERDIR}"

BBFILES += "${LAYERDIR}/recipes-*/*/*.bb \
            ${LAYERDIR}/recipes-*/*/*.bbappend"

BBFILE_COLLECTIONS += "virtual-gpio"
BBFILE_PATTERN_virtual-gpio = "^${LAYERDIR}/"
BBFILE_PRIORITY_virtual-gpio = "8"

LAYERSERIES_COMPAT_virtual-gpio = "scarthgap"
```
